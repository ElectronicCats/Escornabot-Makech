// BluetoothInterface.cpp
/*

Copyright (C) 2014-2019 Escornabot - http://escornabot.com

This program is free software; you can redistribute it and/or
modify it under the terms of the GNU General Public License
as published by the Free Software Foundation; either version 2
of the License, or (at your option) any later version.

This program is distributed in the hope that it will be useful,
but WITHOUT ANY WARRANTY; without even the implied warranty of
MERCHANTABILITY or FITNESS FOR A PARTICULAR PURPOSE.  See the
GNU General Public License for more details.

You should have received a copy of the GNU General Public License
along with this program; if not, write to the Free Software
Foundation, Inc., 51 Franklin Street, Fifth Floor, Boston, MA  02110-1301,
USA.

See LICENSE.txt for details

*/

#include "CatNINAInterface.h"
#include <WiFiNINA.h>
#include <string.h>

#define NL '\n'

//////////////////////////////////////////////////////////////////////

const static char* BUTTONS_PRESSED = "NESWGR";
const static char* BUTTONS_RELEASED = "neswgr";
const static char* SI_PROGRAM = "PRG:";

//////////////////////////////////////////////////////////////////////

#include "EventManager.h"
extern EventManager* EVENTS;

//////////////////////////////////////////////////////////////////////
//////////////////////////////////////////////////////////////////////

CatNINAInterface::CatNINAInterface(const Config* cfg)
{
    _config = cfg;
    _command_idx = 0;
}

//////////////////////////////////////////////////////////////////////
//////////////////////////////////////////////////////////////////////

void CatNINAInterface::init()
{
    ButtonSet::init();
      // Set up the pins!
    WiFi.setPins(SPIWIFI_SS, SPIWIFI_ACK, NINA_RESETN, NINA_GPIO0, &SPIWIFI);

    // check for the WiFi module:
    while (WiFi.status() == WL_NO_MODULE) {
      Serial.println("Communication with WiFi module failed!");
      // don't continue
      delay(1000);
    }
    String fv = WiFi.firmwareVersion();
    Serial.println(fv);
    if (fv < "1.0.0") {
      Serial.println("Please upgrade the firmware");
      while (1) delay(10);
    }
    Serial.println("Firmware OK");
}

//////////////////////////////////////////////////////////////////////
//////////////////////////////////////////////////////////////////////

void CatNINAInterface::scanButtons()
{
    
}

//////////////////////////////////////////////////////////////////////
//////////////////////////////////////////////////////////////////////

bool CatNINAInterface::_readLine()
{
    
}

//////////////////////////////////////////////////////////////////////
//////////////////////////////////////////////////////////////////////

void CatNINAInterface::MoveExecuting(MOVE move)
{

}

//////////////////////////////////////////////////////////////////////
//////////////////////////////////////////////////////////////////////

void CatNINAInterface::MoveExecuted(MOVE move)
{

}

//////////////////////////////////////////////////////////////////////
//////////////////////////////////////////////////////////////////////

void CatNINAInterface::MoveAdded(MOVE move)
{

}

//////////////////////////////////////////////////////////////////////
//////////////////////////////////////////////////////////////////////

void CatNINAInterface::ProgramStarted(uint8_t total_moves)
{

}

//////////////////////////////////////////////////////////////////////
//////////////////////////////////////////////////////////////////////

void CatNINAInterface::ProgramFinished()
{

}

//////////////////////////////////////////////////////////////////////
//////////////////////////////////////////////////////////////////////

void CatNINAInterface::ProgramReset()
{

}

//////////////////////////////////////////////////////////////////////
//////////////////////////////////////////////////////////////////////

void CatNINAInterface::ProgramAborted(uint8_t executed, uint8_t total)
{

}

//////////////////////////////////////////////////////////////////////
//////////////////////////////////////////////////////////////////////


// EOF
